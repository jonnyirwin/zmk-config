## boards/shields/phantom/Kconfig.defconfig
```kconfig
if SHIELD_PHANTOM_LEFT

config ZMK_KEYBOARD_NAME
    default "Phantom"

config ZMK_SPLIT_ROLE_CENTRAL
    default y

endif # SHIELD_PHANTOM_LEFT

if SHIELD_PHANTOM_LEFT || SHIELD_PHANTOM_RIGHT

config ZMK_SPLIT
    default y

endif # SHIELD_PHANTOM_LEFT || SHIELD_PHANTOM_RIGHT
```

## boards/shields/phantom/Kconfig.shield
```kconfig
config SHIELD_PHANTOM_LEFT
    def_bool $(shields_list_contains,phantom_left)

config SHIELD_PHANTOM_RIGHT
    def_bool $(shields_list_contains,phantom_right)
```

## config/boards/shields/berylline_dongle/Kconfig.defconfig
```kconfig
if SHIELD_BERYLLINE_DONGLE

config ZMK_KEYBOARD_NAME
    default "Berylline"

config ZMK_SPLIT_ROLE_CENTRAL
    default y

config ZMK_SPLIT
    default y

config ZMK_SPLIT_BLE_CENTRAL_PERIPHERALS
    default 2

config BT_MAX_CONN
    default 7

config BT_MAX_PAIRED
    default 7

endif
```

## config/boards/shields/berylline_dongle/Kconfig.shield
```kconfig
config SHIELD_BERYLLINE_DONGLE
    def_bool $(shields_list_contains,berylline_dongle)
```

## config/boards/shields/cheapino/Kconfig.defconfig
```kconfig
if SHIELD_CHEAPINO

config ZMK_KEYBOARD_NAME
    default "Cheapino"

config ZMK_BOARD_COMPAT
    default y

endif
```

## config/west.yml
```yaml
manifest:
  remotes:
    - name: zmkfirmware
      url-base: https://github.com/zmkfirmware
    - name: davidphilipbarr
      url-base: https://github.com/davidphilipbarr
    - name: caksoylar
      url-base: https://github.com/caksoylar
    - name: jonnyirwin
      url-base: https://github.com/jonnyirwin
    - name: kilipan
      url-base: https://github.com/kilipan
    - name: jcmkk3
      url-base: https://github.com/jcmkk3
    - name: carrefinho
      url-base: https://github.com/carrefinho
  projects:
    - name: zmk
      remote: zmkfirmware
      revision: v0.3-branch
      import: app/west.yml
    - name: nicehatharry
      remote: davidphilipbarr
      clone-depth: 1
      revision: main
    - name: zmk-rgbled-widget
      remote: caksoylar
      revision: main
    - name: zmk-keyboards-phantom
      remote: jonnyirwin
      revision: main
    - name: zmk-keyboards-teenspirit
      remote: kilipan
      revision: main
    - name: zmk-keyboard-berylline
      remote: jcmkk3
      revision: main
    - name: prospector-zmk-module
      remote: carrefinho
      revision: main
  self:
    path: config
```
