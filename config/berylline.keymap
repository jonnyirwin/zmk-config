/*
 * Berylline keymap — 30-key wireless split.
 * SPDX-License-Identifier: MIT
 */

#include <behaviors.dtsi>
#include <dt-bindings/zmk/keys.h>
#define CK  0
#define NAV 1
#define SYM 2
#define FN  3
#define SYS   4
#define MOUSE 5

#define BOARD_30
#define ZMK_HAS_BLE

#include "includes/layers.h"

/ {
    chosen {
        zmk,kscan = &kscan_facedown;
    };
};

#include "includes/base_layers.dtsi"
