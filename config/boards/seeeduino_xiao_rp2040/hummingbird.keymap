/*
 * Hummingbird keymap — 30-key wired split (Seeeduino XIAO RP2040).
 * SPDX-License-Identifier: MIT
 */

#include <behaviors.dtsi>
#include <dt-bindings/zmk/keys.h>

#define CK  0
#define NAV 1
#define SYM 2
#define FN  3
#define SYS   4
#define MOUSE 5

#define BOARD_30

#include "../../includes/layers.h"

#include "../../includes/base_layers.dtsi"
