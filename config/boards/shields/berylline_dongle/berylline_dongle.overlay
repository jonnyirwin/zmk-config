/ {
    chosen {
        zmk,kscan = &kscan_facedown;
    };

    kscan_facedown: kscan_facedown {
        compatible = "zmk,kscan-mock";
        columns = <0>;
        rows = <0>;
        events = <0>;
    };
};
