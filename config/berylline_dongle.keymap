/*
 * Berylline keymap — 30-key wireless split.
 * SPDX-License-Identifier: MIT
 */
#define BOARD_30
#define ZMK_HAS_BLE
#include "includes/layers.h"
/ {
    chosen {
        zmk,kscan = &kscan_facedown;
    };
};
#include "includes/base_layers.dtsi"
